## config/boards/shields/alyx2/Kconfig.defconfig
```kconfig
# Copyright (c) 2020 The ZMK Contributors
# SPDX-License-Identifier: MIT

if SHIELD_ALYX2

config ZMK_KEYBOARD_NAME
    default "alyx2"

config ZMK_POINTING
    default y

# Assuming pointing device uses SPI
config SPI
    default y

endif
```

## config/west.yml
```yaml
manifest:
  remotes:
    - name: petejohanson
      url-base: https://github.com/petejohanson
    - name: zmk
      url-base: https://github.com/zmkfirmware
  projects:
    - name: zmk
      remote: zmk
      revision: main
      import: app/west.yml
    - name: cirque-input-module
      remote: petejohanson
      revision: main
  self:
    path: config
```
